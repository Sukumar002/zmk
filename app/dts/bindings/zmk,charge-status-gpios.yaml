## app/dts/bindings/zmk,charge-status-gpios.yaml
```yaml
description: Optional GPIO input asserted while the peripheral battery charger is actively charging.
compatible: "zmk,charge-status-gpios"
include: base.yaml
properties:
  gpios:
    type: phandle-array
    required: true
```
