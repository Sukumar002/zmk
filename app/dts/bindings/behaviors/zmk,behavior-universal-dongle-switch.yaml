## app/dts/bindings/behaviors/zmk,behavior-universal-dongle-switch.yaml
```yaml
# SPDX-License-Identifier: MIT

description: Request a switch to the other universal dongle keyboard profile

compatible: "zmk,behavior-universal-dongle-switch"

include: one_param.yaml
```

## app/src/split/Kconfig
```kconfig
# Copyright (c) 2022 The ZMK Contributors
# SPDX-License-Identifier: MIT

menuconfig ZMK_SPLIT
    bool "Split keyboard support"

if ZMK_SPLIT

config ZMK_SPLIT_ROLE_CENTRAL
    bool "Split central device"

config ZMK_SPLIT_BLE
    bool "BLE Split"
    default y
    depends on ZMK_BLE
    select BT_USER_PHY_UPDATE
    select BT_AUTO_PHY_UPDATE

config ZMK_SPLIT_WIRED
    bool "Wired Split"
    default y
    depends on DT_HAS_ZMK_WIRED_SPLIT_ENABLED
    select SERIAL
    select RING_BUFFER
    select CRC

config ZMK_SPLIT_PERIPHERAL_HID_INDICATORS
    bool "Peripheral HID Indicators"
    depends on ZMK_HID_INDICATORS
    help
      Enable propagating the HID (LED) Indicator state to the split peripheral(s).

config ZMK_UNIVERSAL_DONGLE_PERIPHERAL_IDENTITY
    bool "Universal dongle peripheral identity"
    depends on ZMK_SPLIT_BLE && !ZMK_SPLIT_ROLE_CENTRAL
    help
      Expose a versioned board-and-side identity characteristic for the experimental
      universal dongle. Enable only on supported split peripherals and set both IDs.

if ZMK_UNIVERSAL_DONGLE_PERIPHERAL_IDENTITY

config ZMK_UNIVERSAL_DONGLE_BOARD_ID
    int "Universal dongle board ID (1=Hana, 2=Chocofi)"
    range 1 2
    help
      Stable board family identifier advertised by this split peripheral.

config ZMK_UNIVERSAL_DONGLE_SIDE_ID
    int "Universal dongle side ID (1=left, 2=right)"
    range 1 2
    help
      Physical side identifier advertised by this split peripheral.

endif # ZMK_UNIVERSAL_DONGLE_PERIPHERAL_IDENTITY

endif # ZMK_SPLIT

rsource "bluetooth/Kconfig"
rsource "wired/Kconfig"
```
